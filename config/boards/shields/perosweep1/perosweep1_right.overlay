/*
 * Copyright (c) 2020 The ZMK Contributors
 *
 * SPDX-License-Identifier: MIT
 */

#include "perosweep1.dtsi"

&default_transform {
	col-offset = <17>;
};

/*  The Mechboards UK board has some pin layout changes.

    While I was able to quickly figure out the left side
    by diffing the patches Mechboards UK did to their QMK
    firmware fork, I had to fight my way through trial and
    error for the right side.

	alfie note: the comments are the pro micro pinout names that qmk uses
*/

/ {
	kscan0: kscan {
		compatible = "zmk,kscan-gpio-direct";
		label = "KSCAN";
        input-gpios
        = <&pro_micro  6 (GPIO_ACTIVE_LOW | GPIO_PULL_UP)> // D7
        , <&pro_micro 18 (GPIO_ACTIVE_LOW | GPIO_PULL_UP)> // F7
        , <&pro_micro 19 (GPIO_ACTIVE_LOW | GPIO_PULL_UP)> // F6
        , <&pro_micro 20 (GPIO_ACTIVE_LOW | GPIO_PULL_UP)> // F5
        , <&pro_micro 21 (GPIO_ACTIVE_LOW | GPIO_PULL_UP)> // F4

        , <&pro_micro 15 (GPIO_ACTIVE_LOW | GPIO_PULL_UP)> // B1
        , <&pro_micro 14 (GPIO_ACTIVE_LOW | GPIO_PULL_UP)> // B3
        , <&pro_micro 16 (GPIO_ACTIVE_LOW | GPIO_PULL_UP)> // B2
        , <&pro_micro  4 (GPIO_ACTIVE_LOW | GPIO_PULL_UP)> // D4
        , <&pro_micro  2 (GPIO_ACTIVE_LOW | GPIO_PULL_UP)> // D1 

        , <&pro_micro  3 (GPIO_ACTIVE_LOW | GPIO_PULL_UP)> // D0
        , <&pro_micro  9 (GPIO_ACTIVE_LOW | GPIO_PULL_UP)> // B5
        , <&pro_micro  5 (GPIO_ACTIVE_LOW | GPIO_PULL_UP)> // C6 
        , <&pro_micro  7 (GPIO_ACTIVE_LOW | GPIO_PULL_UP)> // E6
        , <&pro_micro  8 (GPIO_ACTIVE_LOW | GPIO_PULL_UP)> // B4

        , <&pro_micro  1 (GPIO_ACTIVE_LOW | GPIO_PULL_UP)> // D3
        , <&pro_micro 10 (GPIO_ACTIVE_LOW | GPIO_PULL_UP)> // B6
        ;
    };

// / {
// 	kscan0: kscan {
// 		compatible = "zmk,kscan-gpio-direct";
// 		label = "KSCAN";
//         input-gpios
//         = <&pro_micro  6 (GPIO_ACTIVE_LOW | GPIO_PULL_UP)> // D7
//         , <&pro_micro 18 (GPIO_ACTIVE_LOW | GPIO_PULL_UP)> // F7
//         , <&pro_micro 19 (GPIO_ACTIVE_LOW | GPIO_PULL_UP)> // F6
//         , <&pro_micro 20 (GPIO_ACTIVE_LOW | GPIO_PULL_UP)> // F5
//         , <&pro_micro 21 (GPIO_ACTIVE_LOW | GPIO_PULL_UP)> // F4

//         , <&pro_micro 15 (GPIO_ACTIVE_LOW | GPIO_PULL_UP)> // B1
//         , <&pro_micro 14 (GPIO_ACTIVE_LOW | GPIO_PULL_UP)> // B3
//         , <&pro_micro 16 (GPIO_ACTIVE_LOW | GPIO_PULL_UP)> // B2
//         , <&pro_micro 10 (GPIO_ACTIVE_LOW | GPIO_PULL_UP)> // thumb key 2
//         , <&pro_micro  2 (GPIO_ACTIVE_LOW | GPIO_PULL_UP)> // D1 

//         , <&pro_micro  3 (GPIO_ACTIVE_LOW | GPIO_PULL_UP)> // D0
//         , <&pro_micro  9 (GPIO_ACTIVE_LOW | GPIO_PULL_UP)> // B5
//         , <&pro_micro  5 (GPIO_ACTIVE_LOW | GPIO_PULL_UP)> // thumb key 1 
//         , <&pro_micro  7 (GPIO_ACTIVE_LOW | GPIO_PULL_UP)> // E6
//         , <&pro_micro  8 (GPIO_ACTIVE_LOW | GPIO_PULL_UP)> // B4

//         , <&pro_micro  1 (GPIO_ACTIVE_LOW | GPIO_PULL_UP)> // D4
//         , <&pro_micro  4 (GPIO_ACTIVE_LOW | GPIO_PULL_UP)> // B6
//         ;
//     };
};
